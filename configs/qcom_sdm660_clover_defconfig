## configs/qcom_sdm660_clover_defconfig
```kconfig
# Configuration for building U-Boot as 2nd stage
# bootloader to be flashed as part of boot.img to
# boot partition on Xiaomi Redmi Note 7 phones.

#include "qcom_sdm660_defconfig"

# Otherwise buildman thinks this isn't an ARM platform
CONFIG_ARM=y

# xiaomi-clover is built with no real serial debug uart available,
# it is using ramoops logging instead
# and with pre_console_buffer

# CONFIG_REQUIRE_SERIAL_CONSOLE is not set
# CONFIG_SERIAL_PRESENT is not set
CONFIG_DEBUG_UART_RAMOOPS=y
CONFIG_DEBUG_UART_SKIP_INIT=n

CONFIG_PRE_CONSOLE_BUFFER=y
CONFIG_PRE_CON_BUF_ADDR=0x95100000
CONFIG_PRE_CON_BUF_SZ=16384
```

## configs/qcom_sdm660_lavender_defconfig
```kconfig
# Configuration for building U-Boot as 2nd stage
# bootloader to be flashed as part of boot.img to
# boot partition on Xiaomi Redmi Note 7 phones.

#include "qcom_sdm660_defconfig"

# Otherwise buildman thinks this isn't an ARM platform
CONFIG_ARM=y

# lavender is a bit special, it's device tree is upstream
# and can be built as part of U-Boot build process
# sdm660_defconfig has CONFIG_OF_OMIT_DTB=y
CONFIG_OF_OMIT_DTB=n
CONFIG_DEFAULT_DEVICE_TREE="qcom/sdm660-xiaomi-lavender"
```
